## dts/bindings/behaviors/rotten,behavior-glasses.yaml
```yaml
# SPDX-License-Identifier: MIT

description: Switch the bongo cat glasses (rectangular / thug), kept across restarts

compatible: "rotten,behavior-glasses"

include: zero_param.yaml
```
